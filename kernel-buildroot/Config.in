## kernel-buildroot/Config.in
```kconfig
source "$BR2_EXTERNAL_HYPEROS_PATH/package/runit/Config.in"
source "$BR2_EXTERNAL_HYPEROS_PATH/package/vmm-daemon/Config.in"
source "$BR2_EXTERNAL_HYPEROS_PATH/package/crosvm/Config.in"
source "$BR2_EXTERNAL_HYPEROS_PATH/package/desktop-shell/Config.in"
source "$BR2_EXTERNAL_HYPEROS_PATH/package/vm-control-ui/Config.in"
```

## kernel-buildroot/configs/hyperos_x86_64_defconfig
```kconfig
BR2_x86_64=y
BR2_x86_corei7=y
BR2_CCACHE=y
BR2_TOOLCHAIN_EXTERNAL=y
BR2_TOOLCHAIN_EXTERNAL_BOOTLIN=y
BR2_TOOLCHAIN_EXTERNAL_BOOTLIN_X86_64_CORE_I7_MUSL_STABLE=y
BR2_INIT_NONE=y
BR2_SYSTEM_BIN_SH_DASH=y
BR2_TARGET_GENERIC_HOSTNAME="hyperos"
BR2_TARGET_GENERIC_ISSUE="HyperOS virtualization host"
# BR2_TARGET_GENERIC_GETTY is not set
# BR2_TARGET_GENERIC_REMOUNT_ROOTFS_RW is not set
# BR2_TARGET_ENABLE_ROOT_LOGIN is not set
BR2_ROOTFS_DEVICE_CREATION_DYNAMIC_DEVTMPFS=y
BR2_ROOTFS_USERS_TABLES="$(BR2_EXTERNAL_HYPEROS_PATH)/board/users.txt"
BR2_ROOTFS_OVERLAY="$(BR2_EXTERNAL_HYPEROS_PATH)/rootfs-overlay"
BR2_ROOTFS_POST_BUILD_SCRIPT="$(BR2_EXTERNAL_HYPEROS_PATH)/board/post-build.sh"
BR2_ROOTFS_POST_IMAGE_SCRIPT="$(BR2_EXTERNAL_HYPEROS_PATH)/board/post-image.sh"
BR2_ROOTFS_POST_SCRIPT_ARGS="-c $(BR2_EXTERNAL_HYPEROS_PATH)/board/genimage.cfg"
BR2_LINUX_KERNEL=y
BR2_LINUX_KERNEL_CUSTOM_VERSION=y
BR2_LINUX_KERNEL_CUSTOM_VERSION_VALUE="6.12.20"
BR2_LINUX_KERNEL_USE_CUSTOM_CONFIG=y
BR2_LINUX_KERNEL_CUSTOM_CONFIG_FILE="$(BR2_EXTERNAL_HYPEROS_PATH)/kernel/hyperos.config"
BR2_LINUX_KERNEL_BZIMAGE=y
BR2_LINUX_KERNEL_INSTALL_TARGET=y
BR2_LINUX_KERNEL_NEEDS_HOST_OPENSSL=y
BR2_LINUX_KERNEL_NEEDS_HOST_LIBELF=y
BR2_PACKAGE_BUSYBOX=y
BR2_PACKAGE_BUSYBOX_SHOW_OTHERS=y
BR2_PACKAGE_BUSYBOX_CONFIG_FRAGMENT_FILES="$(BR2_EXTERNAL_HYPEROS_PATH)/configs/busybox.fragment"
BR2_PACKAGE_RUNIT=y
BR2_PACKAGE_VMM_DAEMON=y
BR2_PACKAGE_CROSVM=y
BR2_PACKAGE_JQ=y
BR2_PACKAGE_SOCAT=y
BR2_PACKAGE_BTRFS_PROGS=y
BR2_PACKAGE_IPROUTE2=y
BR2_PACKAGE_NFTABLES=y
BR2_PACKAGE_UTIL_LINUX=y
BR2_PACKAGE_UTIL_LINUX_BINARIES=y
BR2_PACKAGE_UTIL_LINUX_PARTX=y
BR2_TARGET_ROOTFS_EROFS=y
BR2_TARGET_ROOTFS_EROFS_LZ4HC=y
BR2_TARGET_ROOTFS_EROFS_LZ4HC_LEVEL=9
BR2_TARGET_ROOTFS_EROFS_DEDUPE=y
BR2_TARGET_ROOTFS_EROFS_ZTAILPACKING=y
# BR2_TARGET_ROOTFS_TAR is not set
BR2_TARGET_GRUB2=y
BR2_TARGET_GRUB2_I386_PC=y
BR2_TARGET_GRUB2_X86_64_EFI=y
BR2_TARGET_GRUB2_BOOT_PARTITION="hd0,gpt1"
BR2_TARGET_GRUB2_BUILTIN_MODULES_PC="boot linux fat part_gpt part_msdos normal biosdisk search search_label serial terminal configfile echo test"
BR2_TARGET_GRUB2_BUILTIN_MODULES_EFI="boot linux fat part_gpt part_msdos normal efi_gop efi_uga all_video search search_label serial terminal configfile echo test"
BR2_TARGET_GRUB2_INSTALL_TOOLS=y
BR2_PACKAGE_HOST_DOSFSTOOLS=y
BR2_PACKAGE_HOST_GENIMAGE=y
BR2_PACKAGE_HOST_MTOOLS=y
BR2_PACKAGE_HOST_BTRFS_PROGS=y
BR2_PACKAGE_HOST_ZSTD=y
```

## kernel-buildroot/package/crosvm/Config.in
```kconfig
config BR2_PACKAGE_CROSVM
	bool "crosvm"
	depends on BR2_x86_64
	depends on BR2_USE_MMU
	depends on BR2_TOOLCHAIN_HAS_THREADS
	depends on !BR2_STATIC_LIBS
	select BR2_PACKAGE_LIBCAP
	select BR2_PACKAGE_WAYLAND
	help
	  Build the pinned crosvm and minijail sources for musl, with
	  balloon, 2D GPU, TAP networking, and x86_64 seccomp policies.
	  Requires host Cargo/Rust (musl target), Python 3, and libclang.
```

## kernel-buildroot/package/desktop-shell/Config.in
```kconfig
config BR2_PACKAGE_DESKTOP_SHELL
	bool "desktop-shell"
	depends on BR2_x86_64
	depends on BR2_TOOLCHAIN_HAS_THREADS
	depends on !BR2_STATIC_LIBS
	depends on BR2_PACKAGE_HAS_UDEV
	select BR2_PACKAGE_LIBDRM
	select BR2_PACKAGE_LIBINPUT
	select BR2_PACKAGE_LIBXKBCOMMON
	select BR2_PACKAGE_WAYLAND
	select BR2_PACKAGE_SEATD
	select BR2_PACKAGE_SEATD_DAEMON
	select BR2_PACKAGE_FONTCONFIG
	select BR2_PACKAGE_FREETYPE
	select BR2_PACKAGE_DEJAVU
	help
	  Build the local UI crate for musl using host Cargo/Rust.
```

## kernel-buildroot/package/runit/Config.in
```kconfig
config BR2_PACKAGE_RUNIT
	bool "runit"
	depends on BR2_x86_64
	depends on BR2_INIT_NONE
	help
	  HyperOS init and service supervision (Linux x86_64 only).
```

## kernel-buildroot/package/vm-control-ui/Config.in
```kconfig
config BR2_PACKAGE_VM_CONTROL_UI
	bool "vm-control-ui"
	depends on BR2_x86_64
	depends on BR2_TOOLCHAIN_HAS_THREADS
	depends on !BR2_STATIC_LIBS
	select BR2_PACKAGE_WAYLAND
	select BR2_PACKAGE_LIBXKBCOMMON
	select BR2_PACKAGE_XKEYBOARD_CONFIG
	select BR2_PACKAGE_FONTCONFIG
	select BR2_PACKAGE_FREETYPE
	select BR2_PACKAGE_DEJAVU
	help
	  Build the local UI crate for musl using host Cargo/Rust.
```

## kernel-buildroot/package/vmm-daemon/Config.in
```kconfig
config BR2_PACKAGE_VMM_DAEMON
	bool "vmm-daemon"
	depends on BR2_x86_64
	help
	  HyperOS privileged VMM control-plane daemon supervising crosvm
	  virtual machines over /run/hyperos/vmm.sock (JSON-RPC 2.0).

	  Builds the local Rust crate in vmm-daemon/ against the target
	  x86_64-unknown-linux-musl toolchain and installs /usr/bin/vmm-daemon.
```
